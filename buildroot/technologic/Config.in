## buildroot/technologic/Config.in
```kconfig
source "$BR2_EXTERNAL_TS7970_GRIDEYE_PATH/package/ts7970-grid-eye-demo/Config.in"
```

## buildroot/technologic/configs/ts7970_grideye_defconfig
```kconfig
BR2_arm=y
BR2_cortex_a9=y
BR2_ARM_ENABLE_NEON=y
BR2_ARM_ENABLE_VFP=y
BR2_ARM_FPU_VFPV3=y
BR2_KERNEL_HEADERS_5_10=y
BR2_PACKAGE_GLIBC_UTILS=y
BR2_GCC_VERSION_10_X=y
BR2_TOOLCHAIN_BUILDROOT_CXX=y
# BR2_PIC_PIE is not set
BR2_RELRO_NONE=y
BR2_TARGET_GENERIC_HOSTNAME="tsimx6"
BR2_ROOTFS_DEVICE_CREATION_DYNAMIC_EUDEV=y
# BR2_TARGET_GENERIC_REMOUNT_ROOTFS_RW is not set
BR2_ROOTFS_OVERLAY="$(BR2_EXTERNAL_TS7970_GRIDEYE_PATH)/board/ts7970/overlay"
BR2_LINUX_KERNEL=y
BR2_LINUX_KERNEL_CUSTOM_TARBALL=y
BR2_LINUX_KERNEL_CUSTOM_TARBALL_LOCATION="$(call github,embeddedTS,linux-lts,v5.10.170.6-ts)/linux-v5.10.170.6-ts.tar.gz"
BR2_LINUX_KERNEL_DEFCONFIG="tsimx6_minimal"
BR2_LINUX_KERNEL_UIMAGE=y
BR2_LINUX_KERNEL_XZ=y
BR2_LINUX_KERNEL_UIMAGE_LOADADDR="0x10008000"
BR2_LINUX_KERNEL_DTS_SUPPORT=y
BR2_LINUX_KERNEL_INTREE_DTS_NAME="imx6dl-ts7970 imx6q-ts7970"
BR2_LINUX_KERNEL_INSTALL_TARGET=y
BR2_PACKAGE_LINUX_TOOLS_GPIO=y
BR2_PACKAGE_BUSYBOX_SHOW_OTHERS=y
BR2_PACKAGE_BUSYBOX_WATCHDOG=y
BR2_PACKAGE_BUSYBOX_WATCHDOG_PERIOD="30"
BR2_PACKAGE_XZ=y
BR2_PACKAGE_STRESS=y
BR2_PACKAGE_LIBERATION=y
# BR2_PACKAGE_LIBERATION_SANS is not set
# BR2_PACKAGE_LIBERATION_SERIF is not set
BR2_PACKAGE_MESA3D=y
BR2_PACKAGE_MESA3D_GALLIUM_DRIVER_ETNAVIV=y
BR2_PACKAGE_MESA3D_OPENGL_GLX=y
BR2_PACKAGE_MESA3D_OPENGL_EGL=y
BR2_PACKAGE_MESA3D_OPENGL_ES=y
BR2_PACKAGE_QT5=y
BR2_PACKAGE_QT5BASE_WIDGETS=y
BR2_PACKAGE_QT5BASE_OPENGL_ES2=y
BR2_PACKAGE_QT5BASE_XCB=y
BR2_PACKAGE_QT5BASE_EGLFS=y
BR2_PACKAGE_QT5BASE_FONTCONFIG=y
BR2_PACKAGE_QT5BASE_PNG=y
BR2_PACKAGE_QT5SVG=y
BR2_PACKAGE_XORG7=y
BR2_PACKAGE_XSERVER_XORG_SERVER=y
BR2_PACKAGE_XSERVER_XORG_SERVER_XVFB=y
BR2_PACKAGE_XCB_UTIL_CURSOR=y
BR2_PACKAGE_XAPP_XINIT=y
BR2_PACKAGE_XAPP_XMODMAP=y
BR2_PACKAGE_XAPP_XRDB=y
BR2_PACKAGE_XDRIVER_XF86_INPUT_LIBINPUT=y
BR2_PACKAGE_XDRIVER_XF86_INPUT_MOUSE=y
BR2_PACKAGE_LIBSHA1=y
BR2_PACKAGE_LIBDRI2=y
BR2_PACKAGE_LIBEPOXY=y
BR2_PACKAGE_LIBXKBCOMMON_TOOLS=y
BR2_PACKAGE_TSLIB=y
BR2_PACKAGE_OPENSSH=y
BR2_PACKAGE_KMOD_TOOLS=y
BR2_TARGET_ROOTFS_TAR_XZ=y
BR2_PACKAGE_HOST_KMOD_XZ=y
BR2_PACKAGE_TS7970_GRID_EYE_DEMO=y
BR2_PACKAGE_TS4900_UTILS=y
```

## buildroot/technologic/package/ts7970-grid-eye-demo/Config.in
```kconfig
config BR2_PACKAGE_TS7970_GRID_EYE_DEMO
	bool "ts7970-grid-eye-demo"
	help
	  Grid-EYE display demo on TS-7970
```
